## conf/distro/tropios.conf
```bitbake
DISTRO = "tropios"
DISTRO_NAME = "Tropios (IoT Platform)"
DISTRO_VERSION = "1.0"
LOCALCONF_VERSION = "1"
TARGET_VENDOR = "-poky"

# Override these in poky based distros
TROPIOS_DEFAULT_DISTRO_FEATURES = "largefile opengl ptest multiarch systemd"
TROPIOS_DEFAULT_EXTRA_RDEPENDS = "packagegroup-core-boot"
TROPIOS_DEFAULT_EXTRA_RRECOMMENDS = "kernel-module-af-packet"

DISTRO_FEATURES ?= "${DISTRO_FEATURES_DEFAULT} ${DISTRO_FEATURES_LIBC} ${TROPIOS_DEFAULT_DISTRO_FEATURES}"

PREFERRED_PROVIDER_udev ?= "systemd"
PREFERRED_PROVIDER_udev-utils ?= "systemd"
VIRTUAL-RUNTIME_init_manager = "systemd"
VIRTUAL-RUNTIME_initscripts = ""

DISTRO_FEATURES_append = " systemd"
DISTRO_FEATURES_BACKFILL_CONSIDERED = "sysvinit"
PACKAGECONFIG_append_pn-systemd = " networkd resolved"

DISTRO_EXTRA_RDEPENDS += " ${TROPIOS_DEFAULT_EXTRA_RDEPENDS}"
DISTRO_EXTRA_RRECOMMENDS += " ${TROPIOS_DEFAULT_EXTRA_RRECOMMENDS}"

TCLIBCAPPEND = ""

CONNECTIVITY_CHECK_URIS ?= "https://www.example.com/"

SANITY_TESTED_DISTROS ?= " \
            poky-1.7 \n \
            poky-1.8 \n \
            poky-2.0 \n \
            Ubuntu-14.04 \n \
            Ubuntu-14.10 \n \
            Ubuntu-15.04 \n \
            Ubuntu-15.10 \n \
            Fedora-21 \n \
            Fedora-22 \n \
            Fedora-23 \n \
            CentOS-6.* \n \
            CentOS-7.* \n \
            Debian-7.* \n \
            Debian-8.* \n \
            openSUSE-project-13.2 \n \
            "
#
# OELAYOUT_ABI allows us to notify users when the format of TMPDIR changes in 
# an incompatible way. Such changes should usually be detailed in the commit
# that breaks the format and have been previously discussed on the mailing list 
# with general agreement from the core team.
#
OELAYOUT_ABI = "11"

# QA check settings - a little stricter than the OE-Core defaults
WARN_TO_ERROR_QA = "already-stripped compile-host-path install-host-path \
                    installed-vs-shipped ldflags pn-overrides rpaths staticdev \
                    useless-rpaths"
WARN_QA_remove = "${WARN_TO_ERROR_QA}"
ERROR_QA_append = " ${WARN_TO_ERROR_QA}"
```

## conf/layer.conf
```bitbake
# We have a conf and classes directory, add to BBPATH
BBPATH .= ":${LAYERDIR}"

# We have recipes-* directories, add to BBFILES
BBFILES += "${LAYERDIR}/recipes-*/*/*.bb \
            ${LAYERDIR}/recipes-*/*/*.bbappend"

BBFILE_COLLECTIONS += "tropicao"
BBFILE_PATTERN_tropicao = "^${LAYERDIR}/"
BBFILE_PRIORITY_tropicao = "5"
LAYERVERSION_tropicao = "1"
```
